## main/Kconfig.projbuild
```kconfig
menu "Kids Points 固件"

config WIFI_SSID
    string "Wi-Fi SSID"
    default "YOUR_WIFI_SSID_HERE"

config WIFI_PASSWORD
    string "Wi-Fi password"
    default "YOUR_WIFI_PASSWORD_HERE"

config MQTT_BROKER_HOST
    string "MQTT broker host"
    default "192.168.31.111"

config MQTT_BROKER_PORT
    int "MQTT broker port"
    range 1 65535
    default 1883

config KP_ESPNOW_CHANNEL
    int "离线时 ESP-NOW 固定信道"
    range 1 13
    default 1
    help
      断开 Wi-Fi 后 STA 会反复全信道扫描，ESP-NOW 收发会跟着漂移。
      每次重连失败后把信道钉在这个值上，两台 Passport 才能在外出（无 Wi-Fi）
      时靠 ESP-NOW 直连响铃。两台设备必须配置同一个信道。

config KP_WIFI_RETRY_FAST_TRIES
    int "断网后快速重连次数"
    range 0 20
    default 3
    help
      前 N 次断线按 2s 间隔快速重连（覆盖路由器重启等短暂抖动）；
      之后退避到慢速间隔，把射频让给 ESP-NOW。

config KP_WIFI_RETRY_SLOW_MS
    int "退避后的重连间隔(ms)"
    range 5000 600000
    default 60000
    help
      退避期间信道保持固定，ESP-NOW 才有稳定的收发窗口。间隔越长，
      外出时直连越可靠，回家后自动重连越慢。

choice KIDS_ACTOR
    prompt "绑定孩子"
    default KIDS_ACTOR_BROTHER
config KIDS_ACTOR_BROTHER
    bool "brother（哥哥）"
config KIDS_ACTOR_SISTER
    bool "sister（妹妹）"
endchoice

config ACTOR_CHILD_ID
    string
    default "brother" if KIDS_ACTOR_BROTHER
    default "sister" if KIDS_ACTOR_SISTER

config KP_CHILD_NAME
    string "Home 页面显示的孩子姓名"
    default "小朋友"
    help
        仅用于本机 Home 页面显示。请在已忽略的 sdkconfig.defaults 中配置真实姓名，
        不要将孩子真实姓名提交到源码或 sdkconfig.defaults.example。

config KP_CHILD_ROLE
    string "Home 页面显示的孩子角色"
    default "小朋友"
    help
        仅用于本机 Home 页面显示，例如哥哥或妹妹。

config KIDS_DEVICE_ID
    string "本机互动设备 ID"
    default "ai_passport_brother" if KIDS_ACTOR_BROTHER
    default "ai_passport_sister" if KIDS_ACTOR_SISTER
    help
        本机身份，服务端按 ai_passport_<child_id> 校验，必须保持该命名。

config KIDS_PEER_DEVICE_ID
    string "伙伴互动设备 ID"
    default "ai_passport_sister" if KIDS_ACTOR_BROTHER
    default "ai_passport_brother" if KIDS_ACTOR_SISTER
    help
        Find 按键响铃的目标设备 ID。

config KP_PEER_LABEL
    string
    default "妹妹" if KIDS_ACTOR_BROTHER
    default "哥哥" if KIDS_ACTOR_SISTER
    help
        互动页面对伙伴的称呼，跟随 KIDS_ACTOR 自动切换：哥哥的设备找妹妹，妹妹的设备找哥哥。

config KIDS_USE_OFFICIAL_AVATAR
    bool "Use built-in official avatar artwork"
    default y
    help
        Show the checked-in RGB565A8 brother/sister artwork directly from flash.
        Disable only to use the small vector fallback avatar.

config ENABLE_SCREENSHOT
    bool "Enable USB Serial/JTAG screenshot command"
    default n
    help
        Debug-only SCREENSHOT command. It streams LVGL's existing 20-row flush
        chunks as RGB565LE and never allocates a full-screen framebuffer.

config KIDS_THEME_SISTER
    bool
    default y if KIDS_ACTOR_SISTER

endmenu
```
